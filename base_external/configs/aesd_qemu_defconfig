## base_external/configs/aesd_qemu_defconfig
```kconfig
BR2_x86_i686=y
BR2_DL_DIR="$(TOPDIR)/../buildroot_dl   "
BR2_KERNEL_HEADERS_5_11=y
BR2_SYSTEM_DHCP="eth0"
BR2_LINUX_KERNEL=y
BR2_LINUX_KERNEL_PATCH="4.19.91"
BR2_LINUX_KERNEL_USE_CUSTOM_CONFIG=y
BR2_LINUX_KERNEL_CUSTOM_CONFIG_FILE="board/qemu/aarch64-virt/linux.config "
BR2_LINUX_KERNEL_NEEDS_HOST_OPENSSL=y
BR2_PACKAGE_DROPBEAR=y
BR2_TARGET_ROOTFS_EXT2=y
BR2_TARGET_ROOTFS_EXT2_LABEL=""
# BR2_TARGET_ROOTFS_TAR is not set
BR2_PACKAGE_AESD_ASSIGNMENTS=y
```

## base_external/package/aesd-final/Config.in
```kconfig
config BR2_PACKAGE_AESD_FINAL
	bool "aesd-final"
	help
	  Includes the writer executable, finder.sh and tester.sh in the kernel image.
	  Used to understand buildroot external trees and package builds.
```
